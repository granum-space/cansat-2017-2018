## src/board/omnibus/apps/granum/blinky/Kconfig
```kconfig
#
# For a description of the syntax of this configuration file,
# see the file kconfig-language.txt in the NuttX tools repository.
#

config GRANUM_BLINKY
	bool "blinky test"
	default n
	---help---
		Enable the blinky example

# if GRANUM_BLINKY
# endif # GRANUM_BLINKY
```

## src/board/omnibus/apps/granum/file_test/Kconfig
```kconfig
#
# For a description of the syntax of this configuration file,
# see the file kconfig-language.txt in the NuttX tools repository.
#

config GRANUM_FILE_TEST
	bool "File test"
	default n
	---help---
		Enable the file test example

# if GRANUM_FILE_TEST
# endif # GRANUM_FILE_TEST
```

## src/board/omnibus/apps/granum/gps_test/Kconfig
```kconfig
#
# For a description of the syntax of this configuration file,
# see the file kconfig-language.txt in the NuttX tools repository.
#

config GRANUM_GPS_TEST
	bool "GPS minmea test"
	depends on GPSUTILS_MINMEA_LIB
	default n
	---help---
		Enable the GPS minmea example

# if GRANUM_GPS_TEST
# endif # GRANUM_GPS_TEST
```

## src/board/omnibus/apps/granum/granum/Kconfig
```kconfig
#
# For a description of the syntax of this configuration file,
# see the file kconfig-language.txt in the NuttX tools repository.
#

config GRANUM_GRANUM
	bool "GRANUM flying onboard code"
	default n
	---help---
		You SHOULD enable this

# if GRANUM_GRANUM
# endif # GRANUM_GRANUM
```

## src/board/omnibus/apps/granum/lsm_test/Kconfig
```kconfig
#
# For a description of the syntax of this configuration file,
# see the file kconfig-language.txt in the NuttX tools repository.
#

config GRANUM_LSM_TEST
	bool "LSM303C magnitometer test"
	default n
	---help---
		Enable the LSM303C example

# if GRANUM_LSM_TEST
# endif # GRANUM_LSM_TEST
```

## src/board/omnibus/apps/granum/lumen/Kconfig
```kconfig
#
# For a description of the syntax of this configuration file,
# see the file kconfig-language.txt in the NuttX tools repository.
#

config GRANUM_LUMEN
	bool "lumen test"
	default n
	---help---
		Enable the lumen example

# if GRANUM_LUMEN
# endif # GRANUM_LUMEN
```

## src/board/omnibus/apps/granum/mavlink_test/Kconfig
```kconfig
#
# For a description of the syntax of this configuration file,
# see the file kconfig-language.txt in the NuttX tools repository.
#

config GRANUM_MAVLINK_TEST
	bool "MAVLink protocol with MPU6000 test"
	default n
	---help---
		Enable the MAVLink example

# if GRANUM_MAVLINK_TEST
# endif # GRANUM_MAVLINK_TEST
```

## src/board/omnibus/apps/granum/mpu_test/Kconfig
```kconfig
#
# For a description of the syntax of this configuration file,
# see the file kconfig-language.txt in the NuttX tools repository.
#

config GRANUM_MPU_TEST
	bool "MPU6000 test"
	default n
	---help---
		Enable the MPU6000 example

# if GRANUM_MPU_TEST
# endif # GRANUM_MPU_TEST
```

## src/board/omnibus/apps/granum/nrf_test/Kconfig
```kconfig
#
# For a description of the syntax of this configuration file,
# see the file kconfig-language.txt in the NuttX tools repository.
#

config GRANUM_NRF_TEST
	bool "NRF24L01+ test"
	default n
	---help---
		Enable the NRF24L01+ example

# if GRANUM_NRF_TEST
# endif # GRANUM_NRF_TEST
```

## src/board/omnibus/apps/granum/sonar/Kconfig
```kconfig
#
# For a description of the syntax of this configuration file,
# see the file kconfig-language.txt in the NuttX tools repository.
#

config GRANUM_SONAR
	bool "sonar test"
	default n
	---help---
		Enable the sonar example

# if GRANUM_SONAR
# endif # GRANUM_SONAR
```
